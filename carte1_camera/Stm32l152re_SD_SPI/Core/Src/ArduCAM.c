#include "ArduCAM.h"
#include "main.h"
#include <stdio.h>
#include <stdint.h>
//#include "spi.h"
//#include "sccb_bus.h"
//#include "usart.h"

#include "ov2640_regs.h"
//#include "ov5642_regs.h"
//#include "ov5640_regs.h"

extern SPI_HandleTypeDef hspi1;

static void     cs_high();
static void     cs_low();

typedef uint8_t byte;

byte sensor_model = 0;
byte sensor_addr = 0;
byte m_fmt = JPEG;
uint32_t length = 0;
uint8_t is_header = false ;

void ArduCAM_Init(byte model) {
    if (model == OV2640) {
        // Réinitialisation du capteur
        I2C_WriteReg8(0xFF, 0x01);
        I2C_WriteReg8(0x12, 0x80);
        HAL_Delay(100);

        // Initialisation JPEG
        I2C_WriteRegs8(OV2640_JPEG_INIT);
        I2C_WriteRegs8(OV2640_YUV422);
        I2C_WriteRegs8(OV2640_JPEG);

        // Configuration de la résolution %%%%%%%%
        // A MODIFIER ABSOLUMENT AVANT CHAQUE PRISE DE PHOTO
       // %%%%%%%%%%%%%%%%%%%%%%%%%%%%%%%%%%%%%%%%%%

        I2C_WriteRegs8(OV2640_1600x1200_JPEG);
        printf("Caméra OV2640 initialisée.\n");
    } else {
        printf("Modèle de caméra non pris en charge.\n");
        while (1);
    }
}



void set_format(byte fmt)
{
  if (fmt == BMP)
    m_fmt = BMP;
  else
    m_fmt = JPEG;
}

uint8_t bus_read(uint8_t address) {
    uint8_t receivedByte = 0; // Stocker la donnée reçue

    cs_low(); // Activer la communication SPI

    // Envoyer l'adresse (bit MSB à 0 pour lecture)
    HAL_SPI_Transmit(&hspi1, &address, 1, HAL_MAX_DELAY);

    // Lire la donnée
    HAL_SPI_Receive(&hspi1, &receivedByte, 1, HAL_MAX_DELAY);

    cs_high(); // Désactiver la communication SPI

    return receivedByte; // Retourner la valeur lue
}


uint8_t bus_write(uint8_t address, uint8_t value) {
    cs_low(); // Activer la communication SPI

    // Préparer l'adresse avec le bit d'écriture (MSB = 1)
    uint8_t writeAddress = address | 0x80;

    // Envoyer l'adresse
    HAL_SPI_Transmit(&hspi1, &writeAddress, 1, HAL_MAX_DELAY);

    // Envoyer la valeur
    HAL_SPI_Transmit(&hspi1, &value, 1, HAL_MAX_DELAY);

    cs_high(); // Désactiver la communication SPI

    return 1; // Retourner un succès
}


uint8_t read_reg(uint8_t addr)
{
	uint8_t data;
	data = bus_read(addr & 0x7F);
	return data;
}


void write_reg(uint8_t addr, uint8_t data)
{
	 bus_write(addr | 0x80, data); 
}

uint8_t read_fifo(void)
{
	uint8_t data;
	data = bus_read(SINGLE_FIFO_READ);
	return data;
}
void set_fifo_burst() {
    cs_low(); // Activer la communication SPI

    // Envoyer la commande BURST_FIFO_READ
    uint8_t command = BURST_FIFO_READ;
    HAL_SPI_Transmit(&hspi1, &command, 1, HAL_MAX_DELAY);

    cs_high(); // Désactiver la communication SPI
}

void flush_fifo(void)
{
	write_reg(ARDUCHIP_FIFO, FIFO_CLEAR_MASK);
}

void start_capture(void)
{
	write_reg(ARDUCHIP_FIFO, FIFO_START_MASK);
}

void clear_fifo_flag(void )
{
	write_reg(ARDUCHIP_FIFO, FIFO_CLEAR_MASK);
}

uint32_t read_fifo_length(void) {
    uint32_t len1 = read_reg(FIFO_SIZE1); // LSB
    uint32_t len2 = read_reg(FIFO_SIZE2); // Middle byte
    uint32_t len3 = read_reg(FIFO_SIZE3) & 0x7F; // MSB (23 bits max)

    uint32_t length = ((len3 << 16) | (len2 << 8) | len1) & 0x07FFFFF; // Combiner les 23 bits
    return length;
}

//Set corresponding bit  
void set_bit(uint8_t addr, uint8_t bit)
{
	uint8_t temp;
	temp = read_reg(addr);
	write_reg(addr, temp | bit);
}
//Clear corresponding bit 
void clear_bit(uint8_t addr, uint8_t bit)
{
	uint8_t temp;
	temp = read_reg(addr);
	write_reg(addr, temp & (~bit));
}

//Get corresponding bit status
uint8_t get_bit(uint8_t addr, uint8_t bit)
{
  uint8_t temp;
  temp = read_reg(addr);
  temp = temp & bit;
  return temp;
}

//Set ArduCAM working mode
//MCU2LCD_MODE: MCU writes the LCD screen GRAM
//CAM2LCD_MODE: Camera takes control of the LCD screen
//LCD2MCU_MODE: MCU read the LCD screen GRAM
void set_mode(uint8_t mode)
{
  switch (mode)
  {
    case MCU2LCD_MODE:
      write_reg(ARDUCHIP_MODE, MCU2LCD_MODE);
      break;
    case CAM2LCD_MODE:
      write_reg(ARDUCHIP_MODE, CAM2LCD_MODE);
      break;
    case LCD2MCU_MODE:
      write_reg(ARDUCHIP_MODE, LCD2MCU_MODE);
      break;
    default:
      write_reg(ARDUCHIP_MODE, MCU2LCD_MODE);
      break;
  }
}


void OV2640_set_JPEG_size(uint8_t size)
{
	switch(size)
	{
		case OV2640_160x120:
			wrSensorRegs8_8(OV2640_160x120_JPEG);
			break;
		case OV2640_176x144:
			wrSensorRegs8_8(OV2640_176x144_JPEG);
			break;
		case OV2640_320x240:
			wrSensorRegs8_8(OV2640_320x240_JPEG);
			break;
		case OV2640_352x288:
	  	wrSensorRegs8_8(OV2640_352x288_JPEG);
			break;
		case OV2640_640x480:
			wrSensorRegs8_8(OV2640_640x480_JPEG);
			break;
		case OV2640_800x600:
			wrSensorRegs8_8(OV2640_800x600_JPEG);
			break;
		case OV2640_1024x768:
			wrSensorRegs8_8(OV2640_1024x768_JPEG);
			break;
		case OV2640_1280x1024:
			wrSensorRegs8_8(OV2640_1280x1024_JPEG);
			break;
		case OV2640_1600x1200:
			wrSensorRegs8_8(OV2640_1600x1200_JPEG);
			break;
		default:
			wrSensorRegs8_8(OV2640_320x240_JPEG);
			break;
	}
}

//void OV5640_set_JPEG_size(uint8_t size)
//void OV5642_set_JPEG_size(uint8_t size)


//byte wrSensorReg8_8(int regID, int regDat)
//{
//	HAL_Delay(5);
//	sccb_bus_start();
//	if(sccb_bus_write_byte(sensor_addr) == 0)
//	{
//		sccb_bus_stop();
//		return 1;
//	}
//	HAL_Delay(5);
//	if(sccb_bus_write_byte(regID) == 0)
//	{
//		sccb_bus_stop();
//		return 2;
//	}
//	HAL_Delay(5);
//	if(sccb_bus_write_byte(regDat)==0)
//	{
//		sccb_bus_stop();
//		return 3;
//	}
//	sccb_bus_stop();
//	return 0;
//}

byte wrSensorReg8_8(uint8_t regID, uint8_t regData) {
    cs_low(); // Activer la communication SPI
    uint8_t cmd[] = { regID & 0x7F, regData }; // Adresse + donnée
    HAL_SPI_Transmit(&hspi1, cmd, 2, HAL_MAX_DELAY); // Transmettre les données
    cs_high(); // Désactiver la communication SPI
    return 0; // Succès
}



//byte rdSensorReg8_8(uint8_t regID, uint8_t* regDat)
//{
//	HAL_Delay(10);
//	sccb_bus_start();
//	if(sccb_bus_write_byte(sensor_addr) == 0)
//	{
//		sccb_bus_stop();
//		//goto start;
//		return 1;
//	}
//	HAL_Delay(10);
//	if(sccb_bus_write_byte(regID)==0)//ID
//	{
//		sccb_bus_stop();
//		//goto start;
//		return 2;
//	}
//	sccb_bus_stop();
//	HAL_Delay(10);
//	sccb_bus_start();
//	if(sccb_bus_write_byte(sensor_addr|0x01)==0)
//	{
//		sccb_bus_stop();
//		//goto start;
//		return 3;
//	}
//	HAL_Delay(10);
//	*regDat = sccb_bus_read_byte();
//	sccb_bus_send_noack();
//	sccb_bus_stop();
//	return 0;
//}

byte rdSensorReg8_8(uint8_t regID, uint8_t *regData) {
    cs_low(); // Activer la communication SPI
    uint8_t addr = regID | 0x80; // Ajouter le bit de lecture (MSB = 1)
    HAL_SPI_Transmit(&hspi1, &addr, 1, HAL_MAX_DELAY); // Envoyer l'adresse
    HAL_SPI_Receive(&hspi1, regData, 1, HAL_MAX_DELAY); // Lire les données
    cs_high(); // Désactiver la communication SPI
    return 0; // Succès
}

//I2C Array Write 8bit address, 8bit data
//int wrSensorRegs8_8(const struct sensor_reg reglist[])
//{
//  int err = 0;
//  uint16_t reg_addr = 0;
//  uint16_t reg_val = 0;
//  const struct sensor_reg *next = reglist;
//  while ((reg_addr != 0xff) | (reg_val != 0xff))
//  {
//    reg_addr = next->reg;
//    reg_val = next->val;
//    err = wrSensorReg8_8(reg_addr, reg_val);
 //   HAL_Delay(400);
//    next++;
//  }

//  return err;
//}

int wrSensorRegs8_8(const struct sensor_reg reglist[]) {
    int err = 0;
    const struct sensor_reg *next = reglist;

    while ((next->reg != 0xFF) || (next->val != 0xFF)) {
        err = wrSensorReg8_8(next->reg, next->val);
        if (err) {
            return err; // Retourne une erreur si une écriture échoue
        }
        next++;
    }
    return 0; // Succès
}



static void cs_high()
{
	HAL_GPIO_WritePin(ARDUCAM_SPI_CS_PIN_PORT, ARDUCAM_SPI_CS_PIN_NUMBER, SET);
}

static void cs_low()
{
	HAL_GPIO_WritePin(ARDUCAM_SPI_CS_PIN_PORT, ARDUCAM_SPI_CS_PIN_NUMBER, RESET);
}

//I2C Rajout :
#include "ArduCAM.h"

extern I2C_HandleTypeDef hi2c1;


uint8_t I2C_ReadReg8(uint8_t regID, uint8_t *regData) {
    if (HAL_I2C_Master_Transmit(&hi2c1, OV2640_I2C_ADDRESS << 1, &regID, 1, HAL_MAX_DELAY) != HAL_OK) {
        return 1; // Erreur
    }
    if (HAL_I2C_Master_Receive(&hi2c1, OV2640_I2C_ADDRESS << 1, regData, 1, HAL_MAX_DELAY) != HAL_OK) {
        return 1; // Erreur
    }
    return 0; // Succès
}

uint8_t I2C_WriteReg8(uint8_t regID, uint8_t regData) {
    uint8_t data[2] = {regID, regData};
    if (HAL_I2C_Master_Transmit(&hi2c1, OV2640_I2C_ADDRESS << 1, data, 2, HAL_MAX_DELAY) != HAL_OK) {
        return 1; // Erreur
    }
    return 0; // Succès
}

uint8_t I2C_WriteRegs8(const struct sensor_reg reglist[]) {
    const struct sensor_reg *reg = reglist;
    while (!(reg->reg == 0xFF && reg->val == 0xFF)) {
        if (I2C_WriteReg8(reg->reg, reg->val) != 0) {
            return 1; // Erreur
        }
        HAL_Delay(10); // Pause entre les écritures
        reg++;
    }
    return 0; // Succès
}

uint32_t read_fifo_burst(uint8_t *buffer, uint32_t length) {
    if (buffer == NULL || length == 0) {
        return 0; // Validation des arguments
    }

    // Activer la communication SPI (CS bas)
    cs_low();

    // Envoyer la commande de lecture burst
    uint8_t command = BURST_FIFO_READ;
    HAL_SPI_Transmit(&hspi1, &command, 1, HAL_MAX_DELAY);

    // Lire les données en burst
    if (HAL_SPI_Receive(&hspi1, buffer, length, HAL_MAX_DELAY) != HAL_OK) {
        cs_high(); // Désactiver la communication SPI (CS haut)
        return 0; // En cas d'échec
    }

    // Désactiver la communication SPI (CS haut)
    cs_high();

    return length; // Retourner le nombre d'octets lus
}

const struct sensor_reg OV2640_QVGA[]  =
{
	{0xff, 0x0},
	{0x2c, 0xff},
	{0x2e, 0xdf},
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	{0xff,0xff},

};

const struct sensor_reg OV2640_JPEG_INIT[]  =
{
  { 0xff, 0x00 },
  { 0x2c, 0xff },
  { 0x2e, 0xdf },
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  { 0xff, 0xff },
};

const struct sensor_reg OV2640_YUV422[]  =
{
  { 0xFF, 0x00 },
  { 0x05, 0x00 },
  { 0xDA, 0x10 },
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  { 0xff, 0xff },
};

const struct sensor_reg OV2640_JPEG[]  =
{
  { 0xe0, 0x14 },
  { 0xe1, 0x77 },
  { 0xe5, 0x1f },
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  { 0xff, 0xff },
};

/* JPG 160x120 */
const struct sensor_reg OV2640_160x120_JPEG[]  =
{
  { 0xff, 0x01 },
  { 0x12, 0x40 },
  { 0x17, 0x11 },
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  { 0xff, 0xff },
};

/* JPG, 0x176x144 */

const struct sensor_reg OV2640_176x144_JPEG[]  =
{
  { 0xff, 0x01 },
  { 0x12, 0x40 },
  { 0x17, 0x11 },
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  { 0xff, 0xff },
};

/* JPG 320x240 */

const struct sensor_reg OV2640_320x240_JPEG[]  =
{
  { 0xff, 0x01 },
  { 0x12, 0x40 },
  { 0x17, 0x11 },
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  { 0xff, 0xff },
};

/* JPG 352x288 */

const struct sensor_reg OV2640_352x288_JPEG[]  =

{
  { 0xff, 0x01 },
  { 0x12, 0x40 },
  { 0x17, 0x11 },
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  { 0xff, 0xff },
};

/* JPG 640x480 */
const struct sensor_reg OV2640_640x480_JPEG[]  =
{
	{0xff, 0x01},
	{0x11, 0x01},
	{0x12, 0x00}, // Bit[6:4]: Resolution selection//0x02Ϊ����
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  	{0xff, 0xff},
};

/* JPG 800x600 */
const struct sensor_reg OV2640_800x600_JPEG[]  =
{
	{0xff, 0x01},
	{0x11, 0x01},
	{0x12, 0x00}, // Bit[6:4]: Resolution selection//0x02Ϊ����
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  	{0xff, 0xff},
};

/* JPG 1024x768 */
const struct sensor_reg OV2640_1024x768_JPEG[]  =
{
	{0xff, 0x01},
	{0x11, 0x01},
	{0x12, 0x00}, // Bit[6:4]: Resolution selection//0x02Ϊ����
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  {0xff, 0xff},
};

   /* JPG 1280x1024 */
const struct sensor_reg OV2640_1280x1024_JPEG[]  =
{
	{0xff, 0x01},
	{0x11, 0x01},
	{0x12, 0x00}, // Bit[6:4]: Resolution selection//0x02Ϊ����
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  	{0xff, 0xff},
};

   /* JPG 1600x1200 */
const struct sensor_reg OV2640_1600x1200_JPEG[]  =
{
	{0xff, 0x01},
	{0x11, 0x01},
	{0x12, 0x00}, // Bit[6:4]: Resolution selection//0x02Ϊ����
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  	{0xff, 0xff},
};
